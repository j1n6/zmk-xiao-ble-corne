## config/boards/shields/chipper/Kconfig.defconfig
```kconfig
if SHIELD_CHIPPER_DONGLE

config PROSPECTOR_USE_AMBIENT_LIGHT_SENSOR
	default y

# Max 16 characters in keyboard name
config ZMK_KEYBOARD_NAME
    default "Chipper"

config ZMK_SPLIT_ROLE_CENTRAL
    default y

config ZMK_SPLIT
    default y

# Set this to the number of peripherals your dongle will have.
# For a unibody, this would be 1. If you have left and right halves, set it to 2, etc.
config ZMK_SPLIT_BLE_CENTRAL_PERIPHERALS
    default 2

# Set this to ZMK_SPLIT_BLE_CENTRAL_PERIPHERALS + your desired number of BT profiles (default is 5)
config BT_MAX_CONN
    default 6

# Set this to the same number as BT_MAX_CONN
config BT_MAX_PAIRED
    default 6

endif



if SHIELD_CHIPPER_LEFT

config ZMK_KEYBOARD_NAME
	default "Chipper Left"

config ZMK_SPLIT_ROLE_CENTRAL
	default n

endif

if SHIELD_CHIPPER_RIGHT

config ZMK_KEYBOARD_NAME
	default "Chipper Right"
	
endif

if SHIELD_CHIPPER_LEFT || SHIELD_CHIPPER_RIGHT

config ZMK_SPLIT
	default y
 

config ZMK_DISPLAY
	select LV_FONT_MONTSERRAT_26


if ZMK_DISPLAY

config SPI
	default y

config LS0XX
	default y

config LV_Z_BITS_PER_PIXEL
	default 1

choice LV_COLOR_DEPTH
	default LV_COLOR_DEPTH_1

endchoice

config LV_DPI_DEF
	default 30

config LV_Z_VDB_SIZE
	default 16

endif # ZMK_DISPLAY

endif
```

## config/west.yml
```yaml
manifest:
  remotes:
    - name: zmkfirmware
      url-base: https://github.com/zmkfirmware
    # Prospector ZMK Module Remote
    - name: carrefinho                            
      url-base: https://github.com/carrefinho
  projects:
    - name: zmk
      remote: zmkfirmware
      revision: main
      import: app/west.yml
    # Prospector ZMK Module
    - name: prospector-zmk-Module
      remote: carrefinho
      revision: core/zephyr-4-1
  self:
    path: config
```
